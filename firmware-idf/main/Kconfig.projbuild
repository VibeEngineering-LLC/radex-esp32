## firmware-idf/main/Kconfig.projbuild
```kconfig
menu "Radex MR107ion gateway"

    # #USB-1: сборка универсальная — в образе и BLE, и USB; канал выбирается при работе
    # (radex_link.c): прибор на USB -> USB, иначе BLE; Bluetooth выключается в настройках (NVS).
    # Прежний выбор транспорта при сборке (RADEX_TRANSPORT_*) убран.

    config RADEX_USB_POLL_PERIOD_S
        int "USB: период опроса текущих показаний (0x0BC2), с"
        range 10 3600
        default 600
        help
            По умолчанию как у BLE-опроса (10 мин): плотность истории та же.
            Повтор значения в историю не пишется (poll_cycle_observe).

    config RADEX_USB_CLOCK_SYNC
        bool "USB: выставлять часы прибора (RPC 0x0006) по NTP"
        default n
        help
            Единственная команда ЗАПИСИ в прибор. Шлётся только после успешной
            SNTP-синхронизации платы и только при расхождении больше порога.
            ВЫКЛЮЧЕНО по умолчанию (с v1.13.1): по наблюдению за RadexDC установка
            времени закрывает текущую сессию замера прибора и открывает новую
            (сбрасывает «среднюю сессии»), а с платы 0x0006 не проверялась.
            При выключенной опции код синхронизации не компилируется; запрос 0x0006
            остаётся в белом списке radex_ekosf.c, но не вызывается.

    config RADEX_USB_CLOCK_MAX_DRIFT_S
        int "USB: порог расхождения часов прибора, с"
        depends on RADEX_USB_CLOCK_SYNC
        range 2 3600
        default 5

    config RADEX_USB_CLOCK_SYNC_MIN_INTERVAL_H
        int "USB: не чаще одной установки часов за, ч"
        depends on RADEX_USB_CLOCK_SYNC
        range 1 168
        default 6

endmenu
```
